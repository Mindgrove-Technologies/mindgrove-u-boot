## board/mindgrove/secure-iot/Kconfig
```kconfig
if TARGET_SECURE_IOT

config SYS_BOARD
	default "secure-iot"

config SYS_VENDOR
	default "mindgrove"

config SYS_CPU
	default "generic"

config SYS_CONFIG_NAME
	default "mindgrove-secure-iot"

config SYS_TEXT_BASE
	default 0x80200000 if SPL
	default 0x80000000 if !RISCV_SMODE
	default 0x80200000 if RISCV_SMODE

config SPL_TEXT_BASE
	default 0x08000000

config SPL_OPENSBI_LOAD_ADDR
	default 0x80000000

config SYS_TEXT_BASE
	default 0x08000000

config SYS_LOAD_ADDR
	default 0x80000000

config BOARD_SPECIFIC_OPTIONS # dummy
	def_bool y
	select GENERIC_RISCV
	select RISCV_MMODE
	select RISCV_SMODE
	select RAM
    imply MINDGROVE_SERIAL
	imply SPL
	imply SPL_RISCV_MMODE
	imply SPL_OPENSBI
	imply SPL_LOAD_FIT
endif
```

## board/shakti/vcu118/Kconfig
```kconfig
if TARGET_SHAKTI_VCU118

config SYS_BOARD
	default "vcu118"

config SYS_VENDOR
	default "shakti"

config SYS_CPU
	default "generic"

config SYS_CONFIG_NAME
	default "shakti-vcu118"

config SYS_TEXT_BASE
	default 0x80200000 if SPL
	default 0x80000000 if !RISCV_SMODE
	default 0x80200000 if RISCV_SMODE

config SPL_TEXT_BASE
	default 0x08000000

config SPL_OPENSBI_LOAD_ADDR
	default 0x80000000

config SYS_TEXT_BASE
	default 0x08000000

config SYS_LOAD_ADDR
	default 0x80000000

config BOARD_SPECIFIC_OPTIONS # dummy
	def_bool y
	select GENERIC_RISCV
	select RAM
    imply SHAKTI_SERIAL
endif
```

## configs/shakti_vcu118_defconfig
```kconfig
CONFIG_RISCV=y
CONFIG_SYS_MALLOC_F_LEN=0x3000
CONFIG_ENV_SIZE=0x20000
CONFIG_NR_DRAM_BANKS=1
#CONFIG_SPL=y
CONFIG_TARGET_SHAKTI_VCU118=y
CONFIG_ARCH_RV64I=y
CONFIG_RISCV_SMODE=y
CONFIG_DISTRO_DEFAULTS=y
CONFIG_DEFAULT_DEVICE_TREE="shakti-vcu118"
CONFIG_SYS_RELOC_GD_ENV_ADDR=y
CONFIG_BAUDRATE=115200
# CONFIG_REQUIRE_SERIAL_CONSOLE is not set
CONFIG_DEBUG_UART_SHAKTI=y
```
