## board/mindgrove/s24xx/Kconfig
```kconfig
if TARGET_MINDGROVE_S24XX

config SYS_BOARD
    string
    default "s24xx"

config SYS_VENDOR
    string
    default "mindgrove"

config SYS_CPU
    string
    default "generic"

config SYS_CONFIG_NAME
    string
    default "mindgrove-s24xx"

config SYS_TEXT_BASE
    hex
    default 0x80200000 if SPL
    default 0x80000000 if !RISCV_SMODE
    default 0x80200000 if RISCV_SMODE

config SPL_TEXT_BASE
    hex
    default 0x08000000

config SPL_OPENSBI_LOAD_ADDR
    hex
    default 0x80000000

config SYS_LOAD_ADDR
    hex
    default 0x80000000

config BOARD_SPECIFIC_OPTIONS # dummy
    def_bool y
    select GENERIC_RISCV
    select RISCV_MMODE
    select RISCV_SMODE
    select RAM
    imply MINDGROVE_SERIAL
    imply SPL
    imply SPL_RISCV_MMODE
    imply SPL_OPENSBI
    imply SPL_LOAD_FIT

endif
```

## configs/mindgrove-v26xx_defconfig
```kconfig
CONFIG_RISCV=y
CONFIG_TARGET_MINDGROVE_V26XX=y
CONFIG_MINDGROVE_SERIAL=y
CONFIG_DEBUG_UART_MINDGROVE=y
CONFIG_DEBUG_UART_BASE=0x11300
CONFIG_DEBUG_UART_CLOCK=1000000000
CONFIG_BAUDRATE=12500000
CONFIG_SMP=y
CONFIG_NR_CPUS=4
CONFIG_STACK_SIZE_SHIFT=12
CONFIG_ARCH_RV64I=y
CONFIG_CMODEL_MEDANY=y
CONFIG_RISCV_SMODE=y
CONFIG_DISTRO_DEFAULTS=y
CONFIG_TEXT_BASE=0x80200000
CONFIG_HAS_CUSTOM_SYS_INIT_SP_ADDR=y
CONFIG_CUSTOM_SYS_INIT_SP_ADDR=0x80800000
CONFIG_SYS_MALLOC_LEN=0x00800000
CONFIG_DEFAULT_DEVICE_TREE="mindgrove-v26xx"
CONFIG_SYS_RELOC_GD_ENV_ADDR=y
CONFIG_SKIP_RELOCATE=n
CONFIG_BOOTDELAY=5
CONFIG_ENV_USE_DEFAULT_ENV_TEXT_FILE=y
CONFIG_ENV_DEFAULT_ENV_TEXT_FILE="board/mindgrove/v26xx/boot.env"
CONFIG_USE_BOOTARGS=y
CONFIG_BOOTARGS="earlyprintk console=hvc0,12500000n8 root=/dev/mmcblk0p1 rw rootfs=ext4"
CONFIG_BOOTCOMMAND="load mmc 0:2 ${fdt_addr_r} /boot/mindgrove-v26xx.dtb; load mmc 0:2 ${kernel_addr_r} /boot/uImage; bootm ${kernel_addr_r} - ${fdt_addr_r}"
CONFIG_DISPLAY_CPUINFO=y
CONFIG_DISPLAY_BOARDINFO=y
CONFIG_SYS_PROMPT="Mindgrove U-Boot => "
CONFIG_CMD_BOOTZ=y
CONFIG_CC_OPTIMIZE_FOR_SPEED=y
CONFIG_SPI_MINDGROVE=y
CONFIG_CMD_MMC=y
CONFIG_DM_MMC=y
CONFIG_MMC=y
CONFIG_MMC_SPI=y
CONFIG_MMC_SDHCI=y
CONFIG_MMC_SPEED_MODE_SET=y
CONFIG_SPI=y
CONFIG_CMD_PART=y
CONFIG_CMD_MMC=y
CONFIG_FIT=y
CONFIG_SPL=y
CONFIG_SPL_RISCV_MMODE=y
CONFIG_SPL_OPENSBI=y
CONFIG_SPL_LOAD_FIT=y
CONFIG_SPL_LOAD_FIT_ADDRESS=0x84000000
CONFIG_ENV_SIZE=0x20000
CONFIG_SYS_BOOTM_LEN=0x04000000
CONFIG_SPL_DM_SPI=y
CONFIG_SPL_MMC_SUPPORT=y
```
